## boards/shields/cheapis/Kconfig.defconfig
```kconfig
if SHIELD_CHEAPIS_LEFT

# Name must be less than 16 characters long!
config ZMK_KEYBOARD_NAME
    default "Cheapis"

config ZMK_SPLIT_ROLE_CENTRAL
    default y

endif

if SHIELD_CHEAPIS_LEFT || SHIELD_CHEAPIS_RIGHT

config ZMK_SPLIT
    default y

endif
```

## boards/shields/cheapis/Kconfig.shield
```kconfig
# No whitespace after the comma or in your part name!
config SHIELD_CHEAPIS_LEFT
    def_bool $(shields_list_contains,cheapis_left)

# No whitespace after the comma or in your part name!
config SHIELD_CHEAPIS_RIGHT
    def_bool $(shields_list_contains,cheapis_right)
```
